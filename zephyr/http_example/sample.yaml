## zephyr/http_example/sample.yaml
```yaml
sample:
  description: HTTP Example Application
  name: http-example-app
common:
  build_only: true
  integration_platforms:
    - qemu_x86
tests:
  app.default: {}
```

## zephyr/http_example/west.yml
```yaml
manifest:
  self:
    west-commands: scripts/west-commands.yml

  remotes:
    - name: zephyrproject-rtos
      url-base: https://github.com/zephyrproject-rtos
    - name: u-blox
      url-base: https://github.com/u-blox

  projects:
    - name: zephyr
      remote: zephyrproject-rtos
      revision: main
      import:
        name-allowlist:
        - cmsis      # dummy import to get 'west build' working
    - name: ucxclient
      remote: u-blox
      repo-path: ucxclient.git
      revision: master
```
