## zephyr/Kconfig
```kconfig
config U_CONNECT_CLIENT
        bool "u-blox u-connectXpress AT Client"
        default n
        help
          Enable u-connectXpress AT client for new u-connectXpress modules.

if U_CONNECT_CLIENT

config U_CONNECT_CLIENT_RX_BUFFER_SIZE
    int "RX buffer size"
    default 1024
    help
      The size of the AT RX buffer

config U_CONNECT_CLIENT_URC_QUEUE
    bool "Use URC queue"
    default y
    help
      With this enabled you may execute AT command directly from an URC callback.

if U_CONNECT_CLIENT_URC_QUEUE
config U_CONNECT_CLIENT_URC_QUEUE_SIZE
    int "URC queue buffer size"
    default 1024
    help
      The queue size in bytes
endif # U_CONNECT_CLIENT_URC_QUEUE

endif # U_CONNECT_CLIENT
```

## zephyr/port_test/testcase.yaml
```yaml
common:
  harness: ztest
tests:
  u_connect_client.port:
    platform_allow: qemu_x86
```
